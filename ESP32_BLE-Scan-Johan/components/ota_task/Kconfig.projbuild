## ESP32_BLE-Scan-Johan/components/ota_task/Kconfig.projbuild
```kconfig
menu "BLE Scan - OTA Updates"

config BLESCAN_OTA_FIRMWARE_URL
    string "firmware upgrade url"
    default "https://nas.vonk:444/embedded/blescan.bin"
    help
        URL of server that hosts the firmware image.
endmenu
```

## ESP32_PACT/components/ota_task/Kconfig.projbuild
```kconfig
# erase sdkconfig after changing this file, so it gets rebuild

menu "OTA Updates"

config OTA_FIRMWARE_URL
    string "firmware upgrade url endpoint"
    default "https://nas.vonk:444/embedded/blescan.bin"
    help
        URL of server which hosts the firmware
        image.

config OTA_RECV_TIMEOUT
    int "OTA Receive Timeout"
    default 5000
    help
        Maximum time for reception

endmenu
```
